## boards/ct/ct_mgm240p/Kconfig.ct_mgm240p
```kconfig
# Copyright (c) 2026 CTHINGS.CO
# SPDX-License-Identifier: Apache-2.0

config BOARD_CT_MGM240P
    select SOC_MGM240PA32VNN
```

## boards/ct/ct_mgm240p/Kconfig.defconfig
```kconfig
# Copyright (c) 2026 CTHINGS.CO
# SPDX-License-Identifier: Apache-2.0

if BOARD_CT_MGM240P

config BOARD
    default "ct_mgm240p"

config CMU_HFXO_FREQ
    default 40000000

config CMU_LFXO_FREQ
    default 32768

endif # BOARD_CT_MGM240P
```

## boards/ct/ct_mgm240p/board.yml
```yaml
# Copyright (c) 2026 CTHINGS.CO
# SPDX-License-Identifier: Apache-2.0

board:
  name: ct_mgm240p
  full_name: CTHINGS MGM240P
  vendor: ct
  socs:
    - name: mgm240pa32vnn
```

## boards/ct/ct_mgm240p/ct_mgm240p_defconfig
```kconfig
# Copyright (c) 2026 CTHINGS.CO
# SPDX-License-Identifier: Apache-2.0

CONFIG_SERIAL=y
CONFIG_CONSOLE=y
CONFIG_UART_CONSOLE=y
CONFIG_GPIO=y
CONFIG_LED=y
```
